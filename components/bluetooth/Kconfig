## components/bluetooth/Kconfig
```kconfig
menu "C++ settings"

config LIBCURL_PRESENT
	bool "LibCurl present"
	default false
	help
		Set to true to indicate that LibCurl is present.

config U8G2_PRESENT
	bool "U8G2 present"
	default false
	help
		Set to true to indicate that U8G2 library is present.

config MONGOOSE_PRESENT
	bool "Mongoose present"
	default false
	help
		Set to true to indicate that the Mongoose library is present.

endmenu
```

## components/tests/Kconfig
```kconfig
menu "WiFi Penetration Tool"

config ENABLE_UNIT_TESTS
	bool "Enable unit tests"
	default false
	help
		Set to true to enable ubit tests.

endmenu
```

## components/wifi_controller/Kconfig
```kconfig
# put here your custom config value
menu "Wi-Fi Controller"
    config SCAN_MAX_AP
        int "Maximun AP scanned"
        default 20
        help
        Maximum number of scanned nearby AP
    menu "Management AP"
        config MGMT_AP_SSID
            string "Management AP SSID"
            default "ManagementAP"
            help
            SSID of management AP

        config MGMT_AP_PASSWORD
            string "Management AP Password"
            default "mgmtadmin"
            help
            Password for management AP WPA2 (minimum 8 characters)

        config MGMT_AP_CHANNEL
            int "Management AP channel"
            range 1 13
            default 3
            help
            Channel on which management AP should run
            
        config MGMT_AP_MAX_CONNECTIONS
            int "Maximum number of connected clients"
            range 0 10
            default 1
            help
            Password for management AP

        config MGMT_AP_AUTH_ON
            bool "Password protected management AP"
            default y
            help
                If set to true, WPA2-PSK will be used. Otherwise authentication will be open
                and anyone can connect to this management AP.
    endmenu
endmenu
```

## main/Kconfig
```kconfig
menu "WiFi Penetration Tool"

config DEVICE_ID
  int "Device ID"
  range 1 140
  default 1
  help
      Use it in case you have multiple ESP32 with the same firmware.
      This ID is used to generate unique IP addresses, WiFi access poin names,
      Bluetooth device names, etc.


config ENABLE_UNIT_TESTS
  bool "Enable unit tests"
  default false
  help
    Set to true to enable ubit tests.

endmenu
```

## sdkconfig.defaults
```kconfig
# Device ID. Use it in case you have multiple ESP32 with the same firmware.
# This ID is used to generate unique IP addresses, WiFi access poin names, Bluetooth device names, etc.
CONFIG_DEVICE_ID=1

# This parameter is changed from default value 32 to let you have 20 items in MAC black list.
# Pay attention, that the more items in that list, the more you may need to set this value. Max is 128.
CONFIG_ESP32_WIFI_DYNAMIC_TX_BUFFER_NUM=64

CONFIG_ESP32_WIFI_NVS_ENABLED=n
CONFIG_OTA_ALLOW_HTTP=y

# These settings are required to build BT stack
CONFIG_BT_ENABLED=y
CONFIG_BTDM_CTRL_MODE_BLE_ONLY=n
CONFIG_BTDM_CTRL_MODE_BR_EDR_ONLY=y
CONFIG_BTDM_CTRL_MODE_BTDM=n
CONFIG_BT_CLASSIC_ENABLED=y
CONFIG_BT_SPP_ENABLED=y
CONFIG_BT_BLE_ENABLED=n
# Uncomment it if you want legacy style of Bluetooth pairing - using PIN
# CONFIG_BT_SSP_ENABLED=n

# These settings are required to use custom partition table to enable OTA feature
CONFIG_PARTITION_TABLE_CUSTOM=y
CONFIG_PARTITION_TABLE_CUSTOM_FILENAME="partition_table\\partitions_two_ota.csv"
CONFIG_PARTITION_TABLE_FILENAME="partition_table\\partitions_two_ota.csv"
CONFIG_PARTITION_TABLE_OFFSET=0x8000
CONFIG_PARTITION_TABLE_MD5=y
CONFIG_ESPTOOLPY_FLASHSIZE_4MB=y
CONFIG_ESPTOOLPY_FLASHSIZE="4MB"

# Enable or disable unit-tests
CONFIG_ENABLE_UNIT_TESTS=n

# In case you have problems with watchdog timer (ex. executing long test), then you can disable it.
# Remember that this is very bad practice and you should avoid it by all means
# CONFIG_ESP_TASK_WDT_TIMEOUT_S=50
# CONFIG_ESP_TASK_WDT_CHECK_IDLE_TASK_CPU0=n
# CONFIG_ESP_TASK_WDT_CHECK_IDLE_TASK_CPU1=n

CONFIG_LOG_MAXIMUM_LEVEL=5
```
